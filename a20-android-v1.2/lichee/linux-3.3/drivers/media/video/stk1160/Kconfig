## a20-android-v1.2/lichee/linux-3.3/drivers/media/video/stk1160/Kconfig
```kconfig
config VIDEO_STK1160
	tristate "STK1160 USB video capture support"
	depends on VIDEO_DEV && I2C && SND
	select VIDEOBUF2_VMALLOC
	select VIDEO_SAA711X
	select SND_AC97_CODEC

	---help---
	  This is a video4linux driver for STK1160 based video capture devices.

	  To compile this driver as a module, choose M here: the
	  module will be called stk1160
```
